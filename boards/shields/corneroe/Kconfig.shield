## boards/shields/corneroe/Kconfig.shield
```kconfig
# Copyright (c) 2020 Pete Johanson
# SPDX-License-Identifier: MIT

config SHIELD_CORNEROE_LEFT
    def_bool $(shields_list_contains,corneroe_left)

config SHIELD_CORNEROE_RIGHT
    def_bool $(shields_list_contains,corneroe_right)
```

## boards/shields/corneroe/drivers/input/Kconfig
```kconfig
config INPUT_SYNAPTICS_RMI_I2C
    bool "Synaptics RMI4 I2C touchpad driver"
    default y
    depends on DT_HAS_PARTH_SYNAPTICS_RMI_I2C_ENABLED && SHIELD_CORNEROE_RIGHT
    select INPUT
    help
      Driver for Synaptics RMI4 touchpad over I2C,
      polling register 0 for relative motion reports.
```

## boards/shields/corneroe/dts/bindings/input/parth,synaptics-rmi-i2c.yaml
```yaml
description: Synaptics RMI4 touchpad over I2C (relative mouse polling)

compatible: "parth,synaptics-rmi-i2c"

include:
  - name: i2c-device.yaml

properties:
  poll-interval-ms:
    type: int
    default: 10
    description: Polling interval in milliseconds
```
